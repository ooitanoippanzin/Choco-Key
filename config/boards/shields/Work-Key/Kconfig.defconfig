## config/boards/shields/Work-Key/Kconfig.defconfig
```kconfig
if SHIELD_WORK-KEY_R

config ZMK_KEYBOARD_NAME
    default "Work-Key_R"

config ZMK_SPLIT
    default y

config ZMK_SPLIT_ROLE_CENTRAL
    default y

endif

if SHIELD_WORK-KEY_L

config ZMK_KEYBOARD_NAME
    default "Work-Key_L"

config ZMK_SPLIT
    default y

endif
```

## config/boards/shields/Work-Key/Kconfig.shield
```kconfig
config SHIELD_WORK-KEY_R
    def_bool $(shields_list_contains,Work-Key_R)

config SHIELD_WORK-KEY_L
    def_bool $(shields_list_contains,Work-Key_L)
```

## config/west.yml
```yaml
manifest:
  remotes:
    - name: zmkfirmware
      url-base: https://github.com/zmkfirmware
    - name: sayu-hub
      url-base: https://github.com/sayu-hub
    - name: caksoylar  # <-- new entry
      url-base: https://github.com/caksoylar  
  projects:
    - name: zmk
      remote: zmkfirmware
      revision: v0.3
      import: app/west.yml
    - name: zmk-pmw3610-driver
      remote: sayu-hub
      revision: zmk-0.3
    - name: zmk-rgbled-widget  # <-- new entry
      remote: caksoylar
      revision: v0.3-branch
  self:
    path: config
```
